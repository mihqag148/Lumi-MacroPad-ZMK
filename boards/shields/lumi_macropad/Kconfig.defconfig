## boards/shields/lumi_macropad/Kconfig.defconfig
```kconfig
if SHIELD_LUMI_MACROPAD || SHIELD_LUMI_MACROPAD_TFT

config ZMK_KEYBOARD_NAME
    default "Lumi MacroPad"

config EC11
    default y

config EC11_TRIGGER_GLOBAL_THREAD
    default y

endif
```

## boards/shields/lumi_macropad/Kconfig.shield
```kconfig
config SHIELD_LUMI_MACROPAD
    def_bool $(shields_list_contains,lumi_macropad)

config SHIELD_LUMI_MACROPAD_TFT
    def_bool $(shields_list_contains,lumi_macropad_tft)
```
