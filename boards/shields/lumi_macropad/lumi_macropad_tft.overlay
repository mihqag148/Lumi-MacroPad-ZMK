\
#include <zephyr/dt-bindings/gpio/gpio.h>
#include <zephyr/dt-bindings/pinctrl/nrf-pinctrl.h>
#include <zephyr/dt-bindings/mipi_dbi/mipi_dbi.h>
#include <zephyr/dt-bindings/display/panel.h>
#include "lumi_macropad-common.dtsi"

/*
 * TFT 1.47" ST7789, 172x320
 *
 * Printed pin -> nRF pin:
 * SDA 017 -> P0.17 (MOSI)
 * SCL 020 -> P0.20 (SCK)
 * CS  022 -> P0.22
 * DC  024 -> P0.24
 * RES 100 -> P1.00
 * VDD/BL -> VCC
 * GND -> GND
 *
 * nice!nano's stock SPI1 pinctrl uses other pins which collide with the
 * matrix, so this shield overrides SPI1 pinctrl explicitly.
 */

&pinctrl {
    lumi_tft_spi_default: lumi_tft_spi_default {
        group1 {
            psels = <NRF_PSEL(SPIM_SCK, 0, 20)>,
                    <NRF_PSEL(SPIM_MOSI, 0, 17)>;
        };
    };

    lumi_tft_spi_sleep: lumi_tft_spi_sleep {
        group1 {
            psels = <NRF_PSEL(SPIM_SCK, 0, 20)>,
                    <NRF_PSEL(SPIM_MOSI, 0, 17)>;
            low-power-enable;
        };
    };
};

&spi1 {
    compatible = "nordic,nrf-spim";
    status = "okay";
    pinctrl-0 = <&lumi_tft_spi_default>;
    pinctrl-1 = <&lumi_tft_spi_sleep>;
    pinctrl-names = "default", "sleep";
    cs-gpios = <&gpio0 22 GPIO_ACTIVE_LOW>;
};

/ {
    chosen {
        zephyr,display = &lumi_st7789;
    };

    lumi_mipi_dbi: mipi_dbi {
        compatible = "zephyr,mipi-dbi-spi";
        status = "okay";

        spi-dev = <&spi1>;
        dc-gpios = <&gpio0 24 GPIO_ACTIVE_HIGH>;
        reset-gpios = <&gpio1 0 GPIO_ACTIVE_LOW>;
        write-only;

        #address-cells = <1>;
        #size-cells = <0>;

        lumi_st7789: st7789v@0 {
            compatible = "sitronix,st7789v";
            status = "okay";
            reg = <0>;

            mipi-max-frequency = <8000000>;
            mipi-mode = <MIPI_DBI_MODE_SPI_4WIRE>;

            width = <172>;
            height = <320>;
            x-offset = <34>;
            y-offset = <0>;

            pixel-format = <PANEL_PIXEL_FORMAT_RGB_565>;

            /* Common ST7789 initialization values. */
            vcom = <0x19>;
            gctrl = <0x35>;
            vrhs = <0x12>;
            vdvs = <0x20>;
            mdac = <0x00>;
            gamma = <0x01>;
            lcm = <0x2c>;

            porch-param = [0c 0c 00 33 33];
            cmd2en-param = [5a 69 02 01];
            pwctrl1-param = [a4 a1];
            pvgam-param = [d0 04 0d 11 13 2b 3f 54 4c 18 0d 0b 1f 23];
            nvgam-param = [d0 04 0c 11 13 2c 3f 44 51 2f 1f 1f 20 23];
            ram-param = [00 f0];
            rgb-param = [cd 08 14];
        };
    };
};
